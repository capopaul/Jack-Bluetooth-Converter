## software/a2dp_source/sdkconfig.defaults
```kconfig
# Override some defaults so BT stack is enabled and
# Classic BT is enabled
CONFIG_BT_ENABLED=y
CONFIG_BTDM_CTRL_MODE_BLE_ONLY=n
CONFIG_BTDM_CTRL_MODE_BR_EDR_ONLY=y
CONFIG_BTDM_CTRL_MODE_BTDM=n
CONFIG_BT_BLUEDROID_ENABLED=y
CONFIG_BT_CLASSIC_ENABLED=y
CONFIG_BT_A2DP_ENABLE=y
CONFIG_ESPTOOLPY_FLASHSIZE_4MB=y
CONFIG_ESPTOOLPY_FLASHSIZE="4MB"

# CONFIG_LOG_DEFAULT_LEVEL_NONE is not set
# CONFIG_LOG_DEFAULT_LEVEL_ERROR is not set
# CONFIG_LOG_DEFAULT_LEVEL_WARN is not set
# CONFIG_LOG_DEFAULT_LEVEL_INFO is not set
CONFIG_LOG_DEFAULT_LEVEL_DEBUG=n
# CONFIG_LOG_DEFAULT_LEVEL_VERBOSE is not set

CONFIG_EXAMPLE_SSP_ENABLED=y

# Use the larger factory application partition.
CONFIG_PARTITION_TABLE_SINGLE_APP=n
CONFIG_PARTITION_TABLE_SINGLE_APP_LARGE=y

# CONFIG_BT_LOG_BTC_TRACE_LEVEL_WARNING is not set
CONFIG_BT_LOG_BTC_TRACE_LEVEL_DEBUG=n
CONFIG_BT_LOG_BTC_TRACE_LEVEL=3

# CONFIG_BT_LOG_APPL_TRACE_LEVEL_WARNING is not set
CONFIG_BT_LOG_APPL_TRACE_LEVEL_DEBUG=n
CONFIG_BT_LOG_APPL_TRACE_LEVEL=3
```
